## drivers/gpu/drm/loongson/Kconfig
```kconfig
# SPDX-License-Identifier: GPL-2.0

config DRM_LOONGSON
	tristate "DRM support for Loongson Graphics"
	depends on DRM && PCI
	depends on LOONGARCH || MIPS || COMPILE_TEST
	depends on OF
	select DRM_KMS_HELPER
	select DRM_TTM
	select DRM_TTM_HELPER
	help
	  This is a DRM driver for Loongson graphics integrated in LS7A2000,
	  LS7A1000, LS2K2000 and LS2K1000. Including the DC, GPU, encoders,
	  and HDMI audio etc.

	  If "M" is selected, the module will be called loongson.

	  If in doubt, say "N".
```

## drivers/gpu/drm/lsdc/Kconfig
```kconfig
# SPDX-License-Identifier: GPL-2.0

config DRM_LSDC
	tristate "DRM support for loongson display controller"
	depends on DRM && PCI && (MACH_LOONGSON64 || LOONGARCH || MIPS)
	select OF
	select DRM_KMS_HELPER
	select DRM_TTM
	select DRM_TTM_HELPER
	select DRM_VRAM_HELPER
	default m
	help
	  This is a KMS driver for loongson display controller in the
	  LS7A1000/LS7A2000 bridge chip and LS2K1000/LS2K0500 SoC.
	  If "M" is selected, the module will be called lsdc.

	  If in doubt, say "Y".
```
